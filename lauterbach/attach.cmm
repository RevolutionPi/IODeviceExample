SYSTEM.OPTION DISMODE THUMB
SYSTEM.MODE ATTACH